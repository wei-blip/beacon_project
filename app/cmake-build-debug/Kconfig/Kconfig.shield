## app/cmake-build-debug/Kconfig/Kconfig.shield
```kconfig
osource "/home/rts/tmp/projects/beacon_project_rzd/radio_signalman/app/../modules/rts-zephyr/boards/shields/*/Kconfig.shield"
```

## app_brigade_chief/cmake-build-release/Kconfig/Kconfig.shield.defconfig
```kconfig
osource "/home/rts/tmp/projects/beacon_project_rzd/lora_russia_railways/app_brigade_chief/../modules/rts-zephyr/boards/shields/*/Kconfig.defconfig"
osource "/home/rts/tmp/projects/beacon_project_rzd/lora_russia_railways/app_brigade_chief/../modules/rts-zephyr/boards/shields/*/Kconfig.defconfig"
```

## app_signalman/cmake-build-debug/Kconfig/Kconfig.shield.defconfig
```kconfig
osource "/home/rts/tmp/projects/beacon_project_rzd/lora_russia_railways/app_signalman/../modules/rts-zephyr/boards/shields/*/Kconfig.defconfig"
osource "/home/rts/tmp/projects/beacon_project_rzd/lora_russia_railways/app_signalman/../modules/rts-zephyr/boards/shields/*/Kconfig.defconfig"
```

## app_signalman/cmake-build-release/Kconfig/Kconfig.shield
```kconfig
osource "/home/rts/tmp/projects/beacon_project_rzd/lora_russia_railways/app_signalman/../modules/rts-zephyr/boards/shields/*/Kconfig.shield"
osource "/home/rts/tmp/projects/beacon_project_rzd/lora_russia_railways/app_signalman/../modules/rts-zephyr/boards/shields/*/Kconfig.shield"
```

## modules/rts-zephyr/boards/arm/rs_0022_0/Kconfig.board
```kconfig
# RS_0015_100 board configuration

config BOARD_RS_0022_0
	bool "RS.0022-0 Board"
	depends on SOC_STM32L452XX
```

## modules/rts-zephyr/boards/arm/rs_0022_0/Kconfig.defconfig
```kconfig
# RS_0015_100 board configuration

if BOARD_RS_0022_0

config BOARD
	default "RS.0022-0 Board"
#
# config SPI_STM32_INTERRUPT
# 	default y
# 	depends on SPI

endif # BOARD_RS_0022_0
```

## modules/rts-zephyr/drivers/Kconfig
```kconfig
menu "Device Drivers"

rsource "uwb/Kconfig"
rsource "led_strip/Kconfig"

endmenu
```

## modules/rts-zephyr/subsys/Kconfig
```kconfig
menu "Sub Systems and OS Services"

rsource "meshposition/Kconfig"

rsource "cobs/Kconfig"

rsource "led_utils/Kconfig"

rsource "lora_rr/Kconfig"

rsource "dwm_rr/Kconfig"

rsource "indication_rr/Kconfig"

endmenu
```

## modules/rts-zephyr/subsys/dwm_rr/Kconfig
```kconfig
menuconfig DWM_RR
    bool "DWM Russia railways library"
    default n
	depends on MESHPOSITION
	depends on DW1000_STARTUP_LOADUCODE
    help
        DWM Russia railways library.
```

## modules/rts-zephyr/subsys/indication_rr/Kconfig
```kconfig
menuconfig INDICATION_RR
	bool "Indication Russia railways Remote call library"
	default n
	depends on LED_UTILS
	depends on LED_STRIP
	depends on WS2812_STRIP
	depends on WS2812_STRIP_PWM
	help
	  Enable Indication Russia railways functionality.
```

## modules/rts-zephyr/subsys/lora_rr/Kconfig
```kconfig
menuconfig LORA_RR
	bool "LoRa Russia railways Remote call library"
	default n
	depends on INDICATION_RR
	depends on LORA
	depends on LORA_SX12XX
	depends on HAS_SEMTECH_RADIO_DRIVERS
	help
	  Enable LoRa Russia railways functionality.

if LORA_RR
	config CURRENT_DEVICE_NUM
		int "Device number"
		default 1
		help
			"Device number. Base station has't this value, signalman has value 1, brigade chief 2."

	config NUMBER_OF_DEVICES
		int "Number of devices"
		default 4
		help
			"Number of devices"
endif
```
